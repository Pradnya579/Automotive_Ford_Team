AUTOSAR XML (schema 00050)
package /ARRoot
  can cluster InteriorLightControlCanCluster
  composition sw component type InteriorLightControlCompositionSwComponentType
    component InteriorLightControlSwComponentPrototype
  ecu instance InteriorLightControlEcuInstance
    can communication controller InteriorLightControlCanCommunicationController
    can communication connector InteriorLightControlCanCommunicationConnector
