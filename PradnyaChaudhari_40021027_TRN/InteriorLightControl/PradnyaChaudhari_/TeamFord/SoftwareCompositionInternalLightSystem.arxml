AUTOSAR XML (schema 00050)
package /ARRoot
  flat map InteriorLightFlatMap
    flat instance descriptor InteriorLightFlatInstanceDescripter: ecu-extract-reference=InteriorLightSystem.InteriorLightSystem
  composition sw component type InteriorLightSwComponentType
    component InteriorLightSwComponentProto: type=InteriorLightSwComponentType
    delegation sw connector CentralLightingConnectorProto: outer-port=CentralLighting
    delegation sw connector DashboardConnectoeProto: outer-port=Dashboard
    delegation sw connector FeetLightConnectorProto: outer-port=FeetLight
    delegation sw connector FrontLightConnectorProto: outer-port=FrontLight
  system InteriorLightSystem
    system mapping InteriorLightMapping
      data-mappings:
        sender-receiver-to-signal-mapping=communication-direction=IN
        client-server-to-signal-mapping=communication-direction=OUT
      sw-impl-mappings:
        swc to impl mapping InteriorLightSwcImplMapping: component=InteriorLightRootSwCompositionPrototype.InteriorLightControlSwComponentPrototype
      sw-mappings:
        swc to ecu mapping InteriorLightSwcToEcuMapping: component=InteriorLightRootSwCompositionPrototype.InteriorLightControlSwComponentPrototype.InteriorLightControlSwComponentPrototype, controlled-hw-element=/ARRoot/, ecu-instance=InteriorLightControlEcuInstance, processing-unit=/ARRoot/
    root-software-compositions:
      root sw composition prototype InteriorLightRootSwCompositionPrototype: flat-map=InteriorLightFlatMap, software-composition=InteriorLightSwComponentType
