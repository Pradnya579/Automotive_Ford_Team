AUTOSAR XML (schema 00050)
package /ARRoot
  ecu instance MirrorControlSyatemEcuinstance
