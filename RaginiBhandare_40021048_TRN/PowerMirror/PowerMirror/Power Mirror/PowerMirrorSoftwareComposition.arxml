AUTOSAR XML (schema 00050)
package /ARRoot
  composition sw component type Mirrorontrol
