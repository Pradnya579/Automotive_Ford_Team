AUTOSAR XML (schema 00050)
package /ARRoot
  can cluster CoilLeftCanCluster
  ecu instance CoilLeftEcuInstance
    can communication controller CoilLeftCanCommunicationController
    can communication connector CoilLeftCanCommunicationConnector: comm-controller=CoilLeftCanCommunicationController
  flat map CoilLeftFlatMap: instances=flat-instance-descriptor=CoilLeftSystem.HeatingElementLeft
  system CoilLeftSystem
    system mapping CoilLeftSystemMapping: data-mappings={sender-receiver-to-signal-mapping=communication-direction=OUT, sender-receiver-to-signal-mapping=communication-direction=IN}
      sw-impl-mappings:
        swc to impl mapping CoilLeftSwcToImpMapping: component=CoilLeftRootSoftwareComposition.CoilLeftSwComponentProto
      sw-mappings:
        swc to ecu mapping CoilLeftSwcToEcuMapping: component=CoilLeftRootSoftwareComposition.CoilLeftSwComponentProto
    root-software-compositions:
      root sw composition prototype CoilLeftRootSoftwareComposition
  composition sw component type CoilLeftTopLevelComposition
    component CoilLeftSwComponentProto
    delegation sw connector CoilLeftConnectorProto
  can cluster CoilRightCanCluster
  ecu instance CoilRightEcuInstance
    can communication controller CoilRightCanCommunicationController
    can communication connector CoilRightCanCommunicationConnector
  flat map CoilRightFlatMap: instances=flat-instance-descriptor=CoilRightSystem.DialLedRight
  system CoilRightSystem
    system mapping CoilRightSystemMapping: data-mappings={sender-receiver-to-signal-mapping=communication-direction=OUT, sender-receiver-to-signal-mapping=communication-direction=IN}
      sw-impl-mappings:
        swc to impl mapping CoilRightSwcToImpMapping: component=CoilRightRootSoftwareComposition.CoilRightSwComponentProto
      sw-mappings:
        swc to ecu mapping CoilRightSwcToEcuMapping: component=CoilRightRootSoftwareComposition.CoilRightSwComponentProto
    root-software-compositions:
      root sw composition prototype CoilRightRootSoftwareComposition
  composition sw component type CoilRightTopLevelComposition
    component CoilRightSwComponentProto
    delegation sw connector CoilRightConnectorProto
  can cluster LedDialLeftCanCluster
  ecu instance LedDialLeftEcuInstance
    can communication controller LedDialLeftCanCommunicationController
    can communication connector LedDialLeftCanCommunicationConnector
  flat map LedDialLeftFlatMap: instances=flat-instance-descriptor=LedDialLeftSystem.DialLedLeft
  system LedDialLeftSystem
    system mapping LedDialLeftSystemMapping
      data-mappings:
        client-server-to-signal-mapping=communication-direction=OUT
        sender-receiver-to-signal-mapping=communication-direction=OUT
        sender-receiver-to-signal-mapping=communication-direction=IN
      sw-impl-mappings:
        swc to impl mapping LedDialLeftSwcToImpMapping: component=LedDialLeftRootSoftwareComposition.LedDialLeftSwComponentProto
      sw-mappings:
        swc to ecu mapping LedDialLeftSwToEcuMapping: component=LedDialLeftRootSoftwareComposition.LedDialLeftSwComponentProto, processing-unit=/ARRoot/
    root-software-compositions:
      root sw composition prototype LedDialLeftRootSoftwareComposition
  composition sw component type LedDialLeftTopLevelComposition
    component LedDialLeftSwComponentProto
    delegation sw connector LedDialLeftConnectorProto
  can cluster LedDialRightCanCluster
  ecu instance LedDialRightEcuInstance
    can communication controller LedDialRightCanCommunicationController
    can communication connector LedDialRightCanCommunicationConnector
  flat map LedDialRightFlatMap: instances=flat-instance-descriptor=LedDialRightSystem.DialLedRight
  system LedDialRightSystem
    system mapping LedDialRightSystemMapping
      data-mappings:
        client-server-to-signal-mapping=communication-direction=OUT
        sender-receiver-to-signal-mapping=communication-direction=OUT
        sender-receiver-to-signal-mapping=communication-direction=IN
      sw-impl-mappings:
        swc to impl mapping LedDialRightSwcToImpMapping: component=LedDialRightRootSoftwareComposition.LedDialRightSwComponentProto
      sw-mappings:
        swc to ecu mapping LedDialRightSwToEcuMapping: component=LedDialRightRootSoftwareComposition.LedDialRightSwComponentProto
    root-software-compositions:
      root sw composition prototype LedDialRightRootSoftwareComposition
  composition sw component type LedDialRightTopLevelComposition
    component LedDialRightSwComponentProto
    delegation sw connector LedDialRightConnectorProto
  ecu instance SeatHeatingLeftECUInstance
    can communication controller SeatHeatingLeftCanCommunicationController
    can communication connector SeatHeatingLeftCanCommunicationConnector: comm-controller=SeatHeatingLeftCanCommunicationController
  flat map SeatHeatingLeftFlatMap: instances=flat-instance-descriptor=SeatHeatingLeftSystem.HeatingElementLeft
  system SeatHeatingLeftSystem
    system mapping SeatHeatingLeftSystemMapping
      data-mappings:
        client-server-to-signal-mapping=communication-direction=OUT
        sender-receiver-to-signal-mapping=communication-direction=OUT
        sender-receiver-to-signal-mapping=communication-direction=IN
      sw-impl-mappings:
        swc to impl mapping SeatHeatingLeftSwcToImpleMapping: component-implementation=HeatingElementImpFile, component=SeatHeatingLeftRootSoftwareComposition.SeatHeatingLeftSwComponentProto.SeatHeatingLeftSwComponentProto
      sw-mappings:
        swc to ecu mapping SeatHeatingLeftSwToEcuMapping: component=SeatHeatingLeftRootSoftwareComposition.SeatHeatingLeftSwComponentProto.SeatHeatingLeftSwComponentProto, controlled-hw-element=/ARRoot/, ecu-instance=SeatHeatingLeftECUInstance, processing-unit=/ARRoot/
    root-software-compositions:
      root sw composition prototype SeatHeatingLeftRootSoftwareComposition: software-composition=SeatHeatingLeftTopLevelComposition
  composition sw component type SeatHeatingLeftTopLevelComposition
    component SeatHeatingLeftSwComponentProto: type=SeatHeatingLeftTopLevelComposition
    delegation sw connector SeatHeatingLeftConnectorProto: outer-port=HeatingElementLeft
  ecu instance SeatHeatingRightEcuInstance
    can communication controller SeatHeatingRightCanCommunicationController
    can communication connector SeatHeatingRightCanCommunicationConnector: comm-controller=SeatHeatingRightCanCommunicationController
  flat map SeatHeatingRightFlatMap: instances=flat-instance-descriptor=SeatHeatingRightSystem.HeatingElementRight
  system SeatHeatingRightSystem
    system mapping SeatHeatingRightSystemMapping: data-mappings={sender-receiver-to-signal-mapping=communication-direction=IN, sender-receiver-to-signal-mapping=communication-direction=OUT}
      sw-impl-mappings:
        swc to impl mapping SeatHeatingRighttSwcToImpleMapping: component-implementation=HeatingElementImpFile, component=SeatHeatingRightRootSoftwareComposition.SeatHeatingRightSwComponentProto.SeatHeatingRightSwComponentProto
      sw-mappings:
        swc to ecu mapping SeatHeatingRightSwToEcuMapping: component=SeatHeatingRightRootSoftwareComposition.SeatHeatingRightSwComponentProto
    root-software-compositions:
      root sw composition prototype SeatHeatingRightRootSoftwareComposition: software-composition=SeatHeatingRightTopLevelComposition
  composition sw component type SeatHeatingRightTopLevelComposition
    component SeatHeatingRightSwComponentProto: type=SeatHeatingRightTopLevelComposition
    delegation sw connector SeatHeatingRightConnectorProto: outer-port=HeatingElementRight
  can cluster SeatingHeatingLeftCanCluster
    can physical channel SeatHeatingLeftCanPhysicalChannel: comm-connectors=SeatHeatingLeftCanCommunicationConnector
  can cluster SeatingHeatingRightCanCluster
