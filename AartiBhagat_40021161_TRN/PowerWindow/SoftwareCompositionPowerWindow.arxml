AUTOSAR XML (schema 00050)
package /ARRoot
  flat map PowerWindowBackLeftFlatMap
    flat instance descriptor PowerWindowBackLeftFlatInstanceDescriptor: ecu-extract-reference=PowerWindowBackLeftSystem.PowerWindowBackLeftSystem
  system PowerWindowBackLeftSystem
    system mapping PowerWindowBackLeftSystemMapping
      sw-impl-mappings:
        swc to impl mapping PowerWindowBackLeftSwcToImplMapping: component=PowerWindowBackLeftRootSwCompositionPrototype
      sw-mappings:
        swc to ecu mapping PowerWindowBackLeftSwcToEcuMapping: component=PowerWindowBackLeftRootSwCompositionPrototype, controlled-hw-element=/ARRoot/
    root-software-compositions:
      root sw composition prototype PowerWindowBackLeftRootSwCompositionPrototype: flat-map=PowerWindowBackLeftFlatMap, software-composition=PowerWindowBackLeftTopLevelComposition
  composition sw component type PowerWindowBackLeftTopLevelComposition
    delegation sw connector PositionSensingElementBackLeftConnectorProto
    delegation sw connector PressureSensingElementBackLeftConnectorProto
    delegation sw connector WindowControlSwitchBackLeftConnectorProto
  flat map PowerWindowBackRightFlatMap
    flat instance descriptor PowerWindowBackRightFlatInstanceDescriptor: ecu-extract-reference=PowerWindowBackRightSystem.PowerWindowBackRightSystem
  system PowerWindowBackRightSystem
    system mapping PowerWindowBackRightSystemMapping
      sw-impl-mappings:
        swc to impl mapping PowerWindowBackRightSwcToImplMapping: component=PowerWindowBackRightRootSwCompositionPrototype
      sw-mappings:
        swc to ecu mapping PowerWindowBackRightSwcToEcuMapping: component=PowerWindowBackRightRootSwCompositionPrototype, controlled-hw-element=/ARRoot/
    root-software-compositions:
      root sw composition prototype PowerWindowBackRightRootSwCompositionPrototype: flat-map=PowerWindowBackRightFlatMap, software-composition=PowerWindowBackRightTopLevelComposition
  composition sw component type PowerWindowBackRightTopLevelComposition
    delegation sw connector PositionSensingElementBackRightConnectorProto
    delegation sw connector PressureSensingElementBackRightConnectorProto
    delegation sw connector WindowControlSwitchBackRightConnectorProto
  flat map PowerWindowFrontLeftFlatMap
    flat instance descriptor PowerWindowFrontLeftFlatInstanceDescriptor: ecu-extract-reference=PowerWindowFrontLeftSystem.PowerWindowFrontLeftSystem
  system PowerWindowFrontLeftSystem
    system mapping PowerWindowFrontLeftSystemMapping
      sw-impl-mappings:
        swc to impl mapping PowerWindowFrontLeftSwcToImplMapping: component=PowerWindowFrontLeftRootSwCompositionPrototype
      sw-mappings:
        swc to ecu mapping PowerWindowFrontLeftSwcToEcuMapping: component=PowerWindowFrontLeftRootSwCompositionPrototype, controlled-hw-element=/ARRoot/
    root-software-compositions:
      root sw composition prototype PowerWindowFrontLeftRootSwCompositionPrototype: flat-map=PowerWindowFrontLeftFlatMap, software-composition=PowerWindowFrontLeftTopLevelComposition
  composition sw component type PowerWindowFrontLeftTopLevelComposition
    delegation sw connector PositionSensingElementFrontLeftConnectorProto
    delegation sw connector PressureSensingElementFrontLeftConnectorProto
    delegation sw connector WindowControlSwitchFrontLeftConnectorProto
  flat map PowerWindowFrontRightFlatMap
    flat instance descriptor PowerWindowFrontRightFlatInstanceDescriptor: ecu-extract-reference=PowerWindowFrontRightSystem.PowerWindowFrontRightSystem
  system PowerWindowFrontRightSystem
    system mapping PowerWindowFrontRightSystemMapping
      sw-impl-mappings:
        swc to impl mapping PowerWindowFrontRightSwcToImplMapping: component=PowerWindowFrontRightRootSwCompositionPrototype
      sw-mappings:
        swc to ecu mapping PowerWindowFrontRightSwcToEcuMapping: component=PowerWindowFrontRightRootSwCompositionPrototype, controlled-hw-element=/ARRoot/
    root-software-compositions:
      root sw composition prototype PowerWindowFrontRightRootSwCompositionPrototype: flat-map=PowerWindowFrontRightFlatMap, software-composition=PowerWindowFrontRightTopLevelComposition
  composition sw component type PowerWindowFrontRightTopLevelComposition
    delegation sw connector PositionSensingElementFrontRightConnectorProto
    delegation sw connector PressureSensingElementFrontRightConnectorProto
    delegation sw connector WindowControlSwitchFrontRightConnectorProto
