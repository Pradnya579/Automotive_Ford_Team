AUTOSAR XML (schema 00050)
package /ARRoot
  can cluster PowerWindowCanCluster
  composition sw component type PowerWindowCompositionSwComponentType
    component PowerWindowSwComponentPrototype
  ecu instance PowerWindowEcuInstance
    can communication controller PowerWindowCanCommunicationController
    can communication connector PowerWindowCanCommunicationConnector: comm-controller=PowerWindowCanCommunicationController
