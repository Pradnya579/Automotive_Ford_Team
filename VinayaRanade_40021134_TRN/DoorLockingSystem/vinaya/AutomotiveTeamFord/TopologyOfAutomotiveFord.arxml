AUTOSAR XML (schema 00050)
package /ARRoot
  can cluster DoorLockingSystemCanCluster: can-physical-channel
  ecu instance DoorLockingSystemECUInstance
    can communication controller DoorLockingSystemCANcommunicationController
    can communication controller DoorLockingSystemCANcommunicationConnector
