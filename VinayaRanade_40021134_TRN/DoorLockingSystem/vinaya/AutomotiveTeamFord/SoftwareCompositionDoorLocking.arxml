AUTOSAR XML (schema 00050)
package /ARRoot
  flat map DoorLockFlatMap
    instances flat-instance-descriptor=DoorLockingSystem.BacksideRightIndicationConnectorProto, flat-instance-descriptor=DoorLockingSystem.FrontLeftIndicationConnectorProto, flat-instance-descriptor=DoorLockingSystem.FrontRightIndicationConnectorProto, flat-instance-descriptor=DoorLockingSystem.InteriorLightConnectorProto:
      flat instance descriptor DoorLockFlatInstanceDescriptor: ecu-extract-reference=DoorLockingSystem.BacksideLeftIndicationConnectorProto
  composition sw component type DoorLockSwComponentType
    delegation sw connector BacksideLeftIndicationConnectorProto
    delegation sw connector BacksideRightIndicationConnectorProto
    delegation sw connector FrontLeftIndicationConnectorProto
    delegation sw connector FrontRightIndicationConnectorProto
    delegation sw connector InteriorLightConnectorProto
  system DoorLockingSystem
    system mapping DoorLockSystemMapping: swc-to-ecu-mapping-constraint=ecu-instance=DoorLockingSystemECUInstance
      sw-impl-mappings:
        swc to impl mapping DoorLockSwcToImplMapping: component=DoorLockingRootSwCompositionPrototype
      sw-mappings:
        swc to ecu mapping DoorLockSwToECUMapping: component=DoorLockingRootSwCompositionPrototype, controlled-hw-element=/ARRoot/, processing-unit=/ARRoot/
    root-software-compositions:
      root sw composition prototype DoorLockingRootSwCompositionPrototype: flat-map=DoorLockFlatMap, software-composition=DoorLockSwComponentType
